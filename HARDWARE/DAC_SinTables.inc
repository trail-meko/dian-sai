/* Auto-generated Sin wave tables: peak +/-2047 */

static const int16_t DAC_Sin_N242[242] =
{
         0,     53,    106,    159,    212,    265,    318,    370,
       422,    474,    526,    577,    628,    678,    728,    777,
       826,    874,    922,    969,   1016,   1062,   1107,   1151,
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      -106,    -53
};

static const int16_t DAC_Sin_N249[249] =
{
         0,     52,    103,    155,    206,    258,    309,    360,
       410,    461,    511,    561,    610,    660,    708,    756,
       804,    851,    898,    944,    990,   1035,   1079,   1122,
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      -461,   -410,   -360,   -309,   -258,   -206,   -155,   -103,
       -52
};

static const int16_t DAC_Sin_N250[250] =
{
         0,     51,    103,    154,    205,    257,    308,    358,
       409,    459,    509,    559,    608,    657,    705,    754,
       801,    848,    895,    941,    986,   1031,   1075,   1118,
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      -103,    -51
};

static const int16_t DAC_Sin_N251[251] =
{
         0,     51,    102,    154,    205,    256,    306,    357,
       407,    457,    507,    557,    606,    654,    703,    751,
       798,    845,    891,    937,    983,   1027,   1071,   1115,
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      -154,   -102,    -51
};

static const int16_t DAC_Sin_N252[252] =
{
         0,     51,    102,    153,    204,    255,    305,    355,
       406,    456,    505,    554,    603,    652,    700,    748,
       795,    842,    888,    934,    979,   1024,   1067,   1111,
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      -204,   -153,   -102,    -51
};

static const int16_t DAC_Sin_N254[254] =
{
         0,     51,    101,    152,    202,    253,    303,    353,
       402,    452,    501,    550,    599,    647,    695,    742,
       789,    836,    882,    927,    972,   1016,   1060,   1103,
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      -303,   -253,   -202,   -152,   -101,    -51
};

static const int16_t DAC_Sin_N256[256] =
{
         0,     50,    100,    151,    201,    251,    300,    350,
       399,    449,    497,    546,    594,    642,    690,    737,
       783,    830,    875,    920,    965,   1009,   1052,   1095,
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      -399,   -350,   -300,   -251,   -201,   -151,   -100,    -50
};
