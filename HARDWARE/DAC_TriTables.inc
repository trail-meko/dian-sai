/* Auto-generated Tri wave tables: peak +/-2047 */

static const int16_t DAC_Tri_N242[242] =
{
     -2047,  -2013,  -1979,  -1945,  -1912,  -1878,  -1844,  -1810,
     -1776,  -1742,  -1709,  -1675,  -1641,  -1607,  -1573,  -1539,
     -1506,  -1472,  -1438,  -1404,  -1370,  -1336,  -1303,  -1269,
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     -1979,  -2013
};

static const int16_t DAC_Tri_N249[249] =
{
     -2047,  -2014,  -1981,  -1948,  -1915,  -1883,  -1850,  -1817,
     -1784,  -1751,  -1718,  -1685,  -1652,  -1620,  -1587,  -1554,
     -1521,  -1488,  -1455,  -1422,  -1389,  -1356,  -1324,  -1291,
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     -1751,  -1784,  -1817,  -1850,  -1883,  -1915,  -1948,  -1981,
     -2014
};

static const int16_t DAC_Tri_N250[250] =
{
     -2047,  -2014,  -1981,  -1949,  -1916,  -1883,  -1850,  -1818,
     -1785,  -1752,  -1719,  -1687,  -1654,  -1621,  -1588,  -1556,
     -1523,  -1490,  -1457,  -1425,  -1392,  -1359,  -1326,  -1294,
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     -1981,  -2014
};

static const int16_t DAC_Tri_N251[251] =
{
     -2047,  -2014,  -1982,  -1949,  -1917,  -1884,  -1851,  -1819,
     -1786,  -1753,  -1721,  -1688,  -1656,  -1623,  -1590,  -1558,
     -1525,  -1492,  -1460,  -1427,  -1395,  -1362,  -1329,  -1297,
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     -1949,  -1982,  -2014
};

static const int16_t DAC_Tri_N252[252] =
{
     -2047,  -2015,  -1982,  -1950,  -1917,  -1885,  -1852,  -1820,
     -1787,  -1755,  -1722,  -1690,  -1657,  -1625,  -1592,  -1560,
     -1527,  -1495,  -1462,  -1430,  -1397,  -1365,  -1332,  -1300,
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     -1917,  -1950,  -1982,  -2015
};

static const int16_t DAC_Tri_N254[254] =
{
     -2047,  -2015,  -1983,  -1950,  -1918,  -1886,  -1854,  -1821,
     -1789,  -1757,  -1725,  -1692,  -1660,  -1628,  -1596,  -1563,
     -1531,  -1499,  -1467,  -1435,  -1402,  -1370,  -1338,  -1306,
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     -1854,  -1886,  -1918,  -1950,  -1983,  -2015
};

static const int16_t DAC_Tri_N256[256] =
{
     -2047,  -2015,  -1983,  -1951,  -1919,  -1887,  -1855,  -1823,
     -1791,  -1759,  -1727,  -1695,  -1663,  -1631,  -1599,  -1567,
     -1535,  -1503,  -1471,  -1439,  -1407,  -1375,  -1343,  -1311,
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     -1791,  -1823,  -1855,  -1887,  -1919,  -1951,  -1983,  -2015
};
